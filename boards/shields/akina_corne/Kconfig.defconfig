## boards/shields/akina_corne/Kconfig.defconfig
```kconfig
if SHIELD_AKINA_CORNE_LEFT || SHIELD_AKINA_CORNE_RIGHT

config ZMK_KEYBOARD_NAME
    default "Akina Corne"

config ZMK_SPLIT
    default y

if SHIELD_AKINA_CORNE_LEFT

config ZMK_SPLIT_ROLE_CENTRAL
    default y

endif # SHIELD_AKINA_CORNE_LEFT

endif # SHIELD_AKINA_CORNE_LEFT || SHIELD_AKINA_CORNE_RIGHT
```

## boards/shields/akina_corne/Kconfig.shield
```kconfig
config SHIELD_AKINA_CORNE_LEFT
    def_bool $(shields_list_contains,akina_corne_left)

config SHIELD_AKINA_CORNE_RIGHT
    def_bool $(shields_list_contains,akina_corne_right)
```
